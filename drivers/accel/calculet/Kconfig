## drivers/accel/calculet/Kconfig
```kconfig
# SPDX-License-Identifier: GPL-2.0-only
config DRM_ACCEL_CALCULET
	tristate "Calculet KS1 PCIe accelerator"
	depends on DRM_ACCEL
	depends on PCI && PCI_MSI && HAS_IOMEM
	select CRC32
	help
	  DRM accel driver for CALCULET KS1 PCIe accelerators.

	  Each board is exposed as an accel device node.  The driver
	  provides raw BAR access, bidirectional DMA channels, interrupt
	  and polled completion, process accounting, power management and
	  PCIe soft reset.

	  The userspace interface is described in
	  include/uapi/drm/calculet_accel.h.

	  To compile this driver as a module, choose M here: the module
	  will be called calculet_pci.
```
